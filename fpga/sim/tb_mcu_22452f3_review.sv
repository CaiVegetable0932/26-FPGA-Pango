`timescale 1ns/1ps
// Byte-level interoperability review. Peer frames are generated by commit
// 22452f3 C code; time inputs are synthetic, not UART timing certification.
module tb_mcu_22452f3_review;
 reg clk=0;always #5 clk=~clk;
 reg rst_n=0;reg [63:0] now_us=1000000;
 reg rx_valid=0;reg [7:0] rx_data=0;
 wire tx_valid,session_valid,config_valid,state_valid,event_valid,mapping_valid;
 wire [7:0] tx_data;wire [767:0] state_payload;wire [2111:0] config_entity;
 wire [31:0] config_version;wire signed [63:0] clock_offset_us;
 wire [31:0] clock_error_us;wire [63:0] sync_received_us;
 reg config_ready=1;integer tx_count=0,pos=0,state_count=0,event_count=0,logfile,i;
 reg [7:0] tx[0:63],data[0:289];reg [7:0] last_cmd=0;
 mcu_readonly_client dut(.clk(clk),.rst_n(rst_n),.now_us(now_us),.enable(1'b1),.new_session(32'd100),
 .rx_valid(rx_valid),.rx_data(rx_data),.rx_error(1'b0),.timing_bound_valid(1'b1),.capture_error_us(32'd0),
 .tx_valid(tx_valid),.tx_ready(1'b1),.tx_data(tx_data),.session_valid(session_valid),
 .config_valid(config_valid),.config_ready(config_ready),.config_approved(1'b1),.config_entity(config_entity),.config_version(config_version),
 .state_valid(state_valid),.state_payload(state_payload),.event_valid(event_valid),.event_ready(1'b1),
 .mapping_valid(mapping_valid),.clock_offset_us(clock_offset_us),.clock_error_us(clock_error_us),.sync_received_us(sync_received_us));
 always @(posedge clk) if(rst_n) begin
  if(state_valid)state_count=state_count+1;
  if(event_valid)event_count=event_count+1;
  if(tx_valid)begin
   tx[pos]=tx_data;
   if(pos>=9 && pos==tx[6]+9)begin
    last_cmd=tx[3];tx_count=tx_count+1;
    for(i=0;i<=pos;i=i+1)$fwrite(logfile,"%02x",tx[i]);$fwrite(logfile,"\n");pos=0;
   end else pos=pos+1;
  end
 end
 task feed(input string path,input integer n);integer j;begin
  $readmemh(path,data,0,n-1);
  for(j=0;j<n;j=j+1)begin @(negedge clk);rx_data=data[j];rx_valid=1;@(negedge clk);rx_valid=0;repeat(5)@(negedge clk);end
  repeat(1000)@(negedge clk);
 end endtask
 task start(input integer reconnect);begin
  rst_n=0;repeat(4)@(negedge clk);now_us=1000000;tx_count=0;pos=0;last_cmd=0;state_count=0;event_count=0;rst_n=1;
  wait(tx_count==1);if(last_cmd!=8'h40)$fatal(1,"INFO request");
  if(reconnect)feed("reconnect_info.hex",74);else feed("info.hex",74);
  wait(tx_count==2);if(last_cmd!=8'h41)$fatal(1,"OPEN request");feed("open.hex",34);
  wait(tx_count==3);if(last_cmd!=8'h42)$fatal(1,"CONFIG request");feed("config.hex",290);
  if(config_version!=1 || config_entity[80*8+:32]!=250000)$fatal(1,"CONFIG fields");
  wait(tx_count==4);if(last_cmd!=8'h43)$fatal(1,"STREAM request");feed("stream.hex",30);
  wait(tx_count==5);if(last_cmd!=8'h45)$fatal(1,"SYNC request");
  now_us=1001886;feed("sync.hex",50);
  if(!session_valid || !mapping_valid || clock_offset_us!=0 || clock_error_us!=4)$fatal(1,"handshake or sync");
 end endtask
 // Independent selector verifies the actual firmware calibration flag and
 // changed stale threshold; only the explicit synthetic branch sets bit7.
 reg selector_clear=0,sv=0,fv=0;reg [767:0] payload=0;
 wire fr,selected;wire [2:0] status;wire [31:0] age;
 pose_frame_selector selector(.clk(clk),.rst_n(rst_n),.clear(selector_clear),.state_valid(sv),.state_payload(payload),
 .receive_us(64'd1000100),.mapping_valid(1'b1),.clock_offset_us(64'sd0),.clock_error_us(32'd100),.sync_received_us(64'd999000),
 .frame_valid(fv),.frame_ready(fr),.epoch(64'd1),.frame_id(64'd1),.exposure_us(64'd1001000),
 .result_valid(selected),.result_ready(1'b1),.status(status),.age_us(age));
 task select_sample(input string path,input integer approve,input integer expected);integer j;begin
  @(negedge clk);selector_clear=1;@(negedge clk);selector_clear=0;
  $readmemh(path,data,0,105);for(j=0;j<96;j=j+1)payload[j*8+:8]=data[j+8];
  if(approve)payload[167]=1;
  @(negedge clk);sv=1;@(negedge clk);sv=0;wait(fr);fv=1;@(negedge clk);fv=0;
  wait(selected);#1;if(status!=expected)$fatal(1,"selector expected %0d got %0d",expected,status);
  $display("SELECT %s synthetic_approval=%0d status=%0d age=%0d",path,approve,status,age);repeat(3)@(negedge clk);
 end endtask
 initial begin
  logfile=$fopen("rtl_requests.hex","w");start(0);feed("state.hex",106);
  if(state_count!=1 || state_payload[91*8+:8]!=5 || state_payload[93*8+:8]!=3)$fatal(1,"STATE format");
  feed("reconnect_event.hex",50);wait(tx_count==6);if(last_cmd!=8'h49 || tx[20]!=1)$fatal(1,"event ACK");
  $display("PASS MCU C frames -> current RTL: INFO/OPEN/CONFIG/STREAM/SYNC/STATE/EVENT");
  select_sample("state.hex",0,4);select_sample("state.hex",1,0);select_sample("aged_state.hex",1,3);
  start(1);feed("reconnect_event.hex",50);feed("reconnect_event.hex",50);
  if(event_count!=0 || tx_count!=5 || dut.ack_target!=5)$fatal(1,"reconnect reproduction changed");
  $display("REPRODUCED reconnect event deadlock: MCU replays event1, FPGA expects event6 and sends no ACK");
  $fclose(logfile);$finish;
 end
 initial begin #5000000;$fatal(1,"review timeout");end
endmodule
